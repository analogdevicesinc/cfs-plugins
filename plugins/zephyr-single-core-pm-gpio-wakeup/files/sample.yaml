## plugins/zephyr-single-core-pm-gpio-wakeup/files/sample.yaml
```yaml
sample:
  name: ADI MAX32 GPIO Power Management
tests:
  sample.boards.adi.power_mgmt.gpio_wakeup:
    platform_allow:
      - max32657evkit/max32657
      - max32658evkit/max32658
    tags:
      - power
```
